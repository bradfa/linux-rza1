/*
 * Device Tree Source for the HACHIKO board
 *
 * Copyright (C) 2014 Carlo Caione <carlo@caione.org>
 * Copyright (C) 2012-2013 Renesas Solutions Corp.
 *
 * This file is licensed under the terms of the GNU General Public License
 * version 2.  This program is licensed "as is" without any warranty of any
 * kind, whether express or implied.
 *
 * This program is distributed in the hope that it will be useful,
 * but WITHOUT ANY WARRANTY; without even the implied warranty of
 * MERCHANTABILITY or FITNESS FOR A PARTICULAR PURPOSE.  See the
 * GNU General Public License for more details.
 */

/dts-v1/;
/include/ "skeleton.dtsi"

/ {
	model = "HACHIKO";
	compatible = "renesas,hachiko";

	memory {
		device_type = "memory";
		reg = <0x08000000 0x08000000>;
	};
};
